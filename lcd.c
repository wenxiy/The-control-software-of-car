#include "msp430g2553.h"
#include "lcd.h"
/*************Pin Define***************/
#define  SDA_L     P2OUT &=~BIT3         //输出0
#define  SDA_H     P2OUT |= BIT3         //输出1
#define  SDA_IN    P2DIR &=~BIT3         //设置数据线为输入状态
#define  SDA_OUT   P2DIR |=BIT3         //设置数据线为输出状态
#define  SDA_DATA  P2IN&BIT3            //读入SDA线状态
#define  SCL_L     P2OUT&=~BIT4         //串行时钟线低位
#define  SCL_H     P2OUT |=BIT4        //时钟低位
#define  SCL_OUT   P2DIR |=BIT4         //设置时钟线为输出状态
/***********************Initial code*********************/
void Initial_LY096BG30()
{
	Write_IIC_Command(0xAE);   //display off
	Write_IIC_Command(0x20);	//Set Memory Addressing Mode	
	Write_IIC_Command(0x10);	//00,Horizontal Addressing Mode;01,Vertical Addressing Mode;10,Page Addressing Mode (RESET);11,Invalid
	Write_IIC_Command(0xb0);	//Set Page Start Address for Page Addressing Mode,0-7
	Write_IIC_Command(0xc8);	//Set COM Output Scan Direction
	Write_IIC_Command(0x00);//---set low column address
	Write_IIC_Command(0x10);//---set high column address
	Write_IIC_Command(0x40);//--set start line address
	Write_IIC_Command(0x81);//--set contrast control register
	Write_IIC_Command(0x7f);
	Write_IIC_Command(0xa1);//--set segment re-map 0 to 127
	Write_IIC_Command(0xa6);//--set normal display
	Write_IIC_Command(0xa8);//--set multiplex ratio(1 to 64)
	Write_IIC_Command(0x3F);//
	Write_IIC_Command(0xa4);//0xa4,Output follows RAM content;0xa5,Output ignores RAM content
	Write_IIC_Command(0xd3);//-set display offset
	Write_IIC_Command(0x00);//-not offset
	Write_IIC_Command(0xd5);//--set display clock divide ratio/oscillator frequency
	Write_IIC_Command(0xf0);//--set divide ratio
	Write_IIC_Command(0xd9);//--set pre-charge period
	Write_IIC_Command(0x22); //
	Write_IIC_Command(0xda);//--set com pins hardware configuration
	Write_IIC_Command(0x12);
	Write_IIC_Command(0xdb);//--set vcomh
	Write_IIC_Command(0x20);//0x20,0.77xVcc
	Write_IIC_Command(0x8d);//--set DC-DC enable
	Write_IIC_Command(0x14);//
	Write_IIC_Command(0xaf);//--turn on oled panel 
}
/***********************Picture Code**************************/
extern const unsigned char show1[]=
{
      0x00,0x00,0x00,0x00,0x00,0x00,0x00,0x00,0x00,0x00,0x00,0x00,0x00,0x00,0x00,0x00,
      0x00,0x00,0x00,0x00,0x00,0x00,0x00,0x00,0x00,0x00,0x00,0x00,0x00,0x00,0x00,0x00,
      0x00,0x00,0x00,0x00,0x00,0x00,0x00,0x00,0x00,0x00,0x00,0x00,0x00,0x00,0x00,0x00,
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      0x00,0x00,0x00,0x00,0x00,0x00,0x00,0x00,0x00,0x00,0x00,0x00,0x00,0x00,0x00,0x00
};
/**********************************************
//IIC Start
**********************************************/
void IIC_Start()
{
   SCL_H;		
   SDA_H;
   SDA_L;
   SCL_L;
}

/**********************************************
//IIC Stop
**********************************************/
void IIC_Stop()
{
   SCL_L;
   SDA_L;
   SCL_H;
   SDA_H;
}
/**********************************************
// IIC Write byte
**********************************************/
void Write_IIC_Byte(unsigned char IIC_Byte)
{
	unsigned char i;
	for(i=0;i<8;i++)		
	{
		if(IIC_Byte & 0x80)
		SDA_H;
		else
		SDA_L;
		SCL_H;
		SCL_L;
		IIC_Byte<<=1;
	}
	SDA_H;
	SCL_H;
	SCL_L;
}
/**********************************************
// IIC Write Command
**********************************************/
void Write_IIC_Command(unsigned char IIC_Command)
{
   IIC_Start();
   Write_IIC_Byte(0x78);            //Slave address,SA0=0
   Write_IIC_Byte(0x00);			//write command
   Write_IIC_Byte(IIC_Command); 
   IIC_Stop();
}
/**********************************************
// IIC Write Data
**********************************************/
void Write_IIC_Data(unsigned char IIC_Data)
{
   IIC_Start();
   Write_IIC_Byte(0x78);			
   Write_IIC_Byte(0x40);			//write data
   Write_IIC_Byte(IIC_Data);
   IIC_Stop();
}
/********************************************
// fill_Picture
********************************************/
void fill_picture(unsigned char fill_Data)
{
	unsigned char m,n;
	for(m=0;m<8;m++)
	{
		Write_IIC_Command(0xb0+m);		//page0-page1
		Write_IIC_Command(0x00);		//low column start address
		Write_IIC_Command(0x10);		//high column start address
		for(n=0;n<128;n++)
			{
				Write_IIC_Data(fill_Data);
			}
	}
}
/******************************************
// picture
******************************************/
void Picture_1()
{
  unsigned char x,y;
  unsigned int i=0;
  for(y=0;y<8;y++)
    {
      Write_IIC_Command(0xb0+y);
      Write_IIC_Command(0x00);
      Write_IIC_Command(0x10);
      for(x=0;x<128;x++)
        {
          Write_IIC_Data(show1[i++]);
        }
    }
}

/***********************Delay****************************************/
void Delay_50ms(unsigned int Del_50ms)
{
	unsigned int m;
	for(;Del_50ms>0;Del_50ms--)
		for(m=6245;m>0;m--);
}

void Delay_1ms(unsigned int Del_1ms)
{
	unsigned char j;
	while(Del_1ms--)
	{	
		for(j=0;j<123;j++);
	}
}

/********************************************/

extern const char AsciiFontData[95][16];
LCDControl  LCDCtl;
/*
*LCD_init:液晶屏初始化
*传入参数：void
*返回值：void
*/
void LCD_init()
{
    Initial_LY096BG30();
    Delay_1ms(5);
    LCD_clear();    
    LCD_setXY(0,0); 
}

/*
*LCD_clear: 清屏
*传入参数：void
*返回值：void
*/
void LCD_clear()
{
    fill_picture(0x00);
}

/*
*LCD_setXY:设置LCD的坐标
*传入参数：横坐标0-127，纵坐标0-7
*返回值：0 正常
*		 -1 传入的坐标错误
*/
char LCD_setXY(unsigned char X, unsigned char Y)
{
    unsigned char msb,lsb;
    if(X > 127 || Y > 7)
    {
        return -1;
    }
    Write_IIC_Command(0xB0 | Y); //页
    msb = X & 0xf0;
    msb = msb >> 4;
    lsb = X & 0x0f;
    Write_IIC_Command(0x10 | msb);  //set Column address MSB
    Write_IIC_Command(0x00 | lsb);  //set column address LSB
    LCDCtl.col = X;
    LCDCtl.row = Y;
    return 0;
}
/*
*LCD_drawPoint: 在屏幕上点亮一个点
*传入参数：横坐标0-127，纵坐标0-63，写入方式
*返回值：0 正常
*		 -1 传入的坐标错误
*/
char LCD_drawPoint(unsigned char x , unsigned char y)
{
    if(x > 127 || y > 64 )
        return -1;
    LCD_setXY( x , y / 8);	
    Write_IIC_Data(0x01 << (y%8) );
    return 0;
}

/*
*LCD_drawCharAt:在屏幕上指定的坐标上打印一个字符
*传入参数：打印的字符
*		   横坐标：0-15
*		   纵坐标：0-3
*返回值：0 正常
*        -1 传入的坐标错误
*        -2 字符不可打印
*/
char LCD_drawCharAt( char ch , unsigned char col , unsigned char row)
{
    unsigned char i,x,y;
    if(col > 15 || row > 3)
    {
        return -1;
    }
    x = col * 8;
    y = row * 2;
    if(ch == '\n')
    {
        LCD_setXY( 0 , y + 2);
        return 0;
    }
    else if(ch < 0x20 || ch > 0x7e )
    {
        return (char)-2;
    }

    LCD_setXY( x , y);
    for(i = 0 ; i < 8 ; i++)
        Write_IIC_Data( AsciiFontData[ch - 0x20][i]);
    LCD_setXY( x , y+1);
    for(i = 0 ; i < 8 ; i++)
        Write_IIC_Data( AsciiFontData[ch - 0x20][i+8]);
    return 0;
}
/*
*LCD_drawChar:在屏幕上指定的坐标上打印一个字符
*传入参数：打印的字符
*返回值：0 正常
*        -1 传入的坐标错误
*        -2 字符不可打印
*/
char LCD_drawChar(char ch)
{
    if(LCDCtl.col > 127)
    {
        LCDCtl.col = 0;
        LCDCtl.row += 2;
    }
    return LCD_drawCharAt(ch , (LCDCtl.col / 8) + 1, LCDCtl.row / 2);
}
/*
*LCD_drawStrAt:在屏幕上指定的坐标上打印一个字符串
*传入参数：打印的字符串
*           字符串的长度
*	    横坐标：0-15
*	    纵坐标：0-3
返回值：0 正常
*	-1 打印错误
*	1 字符串的长度为0，不可打印
*/
char LCD_drawStrAt( char * str , unsigned char len , unsigned char col ,unsigned char row)
{
    if(0 == len)
    {
        return 1;
    }
    else
    {
        LCD_drawCharAt(*str++ , col , row );
        return LCD_drawStr(str , len - 1);
    }
}
/*
*LCD_drawStr:在屏幕打印一个字符串
*传入参数：打印的字符串
*	    字符串的长度
*返回值：0 正常
*        -1 打印出错
*/
char LCD_drawStr( char * str , unsigned char len)
{
    while(len --)
    {
        if(LCD_drawChar(*str++ ) != 0 )
            return -1;
    }
    return 0;
}
/*
*LCD_clearLine:清除液晶屏上的一行
*传入参数：清除的行：0-3
*返回值：0 正常
*	-1 传入的行错误
*/
char LCD_clearLine(unsigned char row)
{
    unsigned char i = 0;
    if(row > 3)
    {
        return -1;
    }
    for(i = 0 ; i < 16 ; i++)
    {
        LCD_drawCharAt(' ' , i , row );
    }
    return 0;
}


